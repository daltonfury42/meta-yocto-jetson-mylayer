## conf/layer.conf
```bitbake
# We have a conf and classes directory, add to BBPATH
BBPATH .= ":${LAYERDIR}"

# We have recipes-* directories, add to BBFILES
BBFILES += "${LAYERDIR}/recipes-*/*/*.bb \
                 ${LAYERDIR}/recipes-*/*/*.bbappend"

BBFILE_COLLECTIONS += "yocto-jetson-mylayer"
BBFILE_PATTERN_yocto-jetson-mylayer = "^${LAYERDIR}/"
BBFILE_PRIORITY_yocto-jetson-mylayer = "5"
LAYERVERSION_yocto-jetson-mylayer = "1"
```

## conf/local.conf
```bitbake
IMAGE_FEATURES += "package-management"

PACKAGE_CLASSES ?= "package_rpm package_deb"

CORE_IMAGE_EXTRA_INSTALL += "\
       opencv \
       git \
       cmake \
       aptasas \
"
```
